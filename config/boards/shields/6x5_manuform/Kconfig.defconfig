## config/boards/shields/6x5_manuform/Kconfig.defconfig
```kconfig
if SHIELD_DM_6x5_LEFT

config ZMK_KEYBOARD_NAME
    default "DM_6x5"

config ZMK_SPLIT_ROLE_CENTRAL
    default y

endif

if SHIELD_DM_6x5_LEFT || SHIELD_DM_6x5_RIGHT

config ZMK_SPLIT
    default y

endif
```

## config/boards/shields/6x5_manuform/Kconfig.shield
```kconfig
config SHIELD_DM_6x5_LEFT
    def_bool $(shields_list_contains,DM_6x5_left)

config SHIELD_DM_6x5_RIGHT
    def_bool $(shields_list_contains,DM_6x5_right)
```
