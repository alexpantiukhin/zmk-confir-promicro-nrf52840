// DM_6x5_right.overlay

#include "DM_6x5.dtsi"

&default_transform {
    col-offset = <5>;
};
 
&kscan0 {
    col-gpios
        = <&gpio1 0 0 GPIO_ACTIVE_HIGH> 
        , <&gpio0 11 0 GPIO_ACTIVE_HIGH> 
        , <&gpio1 4 0 GPIO_ACTIVE_HIGH> 
        , <&gpio1 6 0 GPIO_ACTIVE_HIGH>
        , <&gpio0 9 0 GPIO_ACTIVE_HIGH>
        ;
};